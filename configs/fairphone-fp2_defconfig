## configs/fairphone-fp2_defconfig
```kconfig
CONFIG_ARM=y
CONFIG_SYS_BOARD="fairphone-fp2"
CONFIG_SYS_CONFIG_NAME="qcom"
CONFIG_SKIP_LOWLEVEL_INIT=y
CONFIG_SYS_DCACHE_OFF=y
CONFIG_ARCH_SNAPDRAGON=y
CONFIG_TEXT_BASE=0x00008000
CONFIG_NR_DRAM_BANKS=8
CONFIG_HAS_CUSTOM_SYS_INIT_SP_ADDR=y
CONFIG_CUSTOM_SYS_INIT_SP_ADDR=0x00400000
CONFIG_ENV_SIZE=0x20000
CONFIG_ENV_OFFSET=0x0
CONFIG_DEFAULT_DEVICE_TREE="qcom/qcom-msm8974pro-fairphone-fp2"
CONFIG_SYS_LOAD_ADDR=0x10000000
CONFIG_SNAPDRAGON_ARMV7=y
CONFIG_BUTTON_CMD=y
CONFIG_BOOTSTD_FULL=y
CONFIG_BOOTDELAY=3
CONFIG_OF_BOARD_SETUP=y
CONFIG_USE_PREBOOT=y
CONFIG_CONSOLE_RECORD=y
CONFIG_CONSOLE_RECORD_OUT_SIZE=0x6000
CONFIG_SYS_CBSIZE=512
CONFIG_LOG_MAX_LEVEL=7
CONFIG_LOG_DEFAULT_LEVEL=6
# CONFIG_DISPLAY_CPUINFO is not set
CONFIG_DISPLAY_BOARDINFO_LATE=y
CONFIG_CMD_BOOTMENU=y
CONFIG_CMD_MEMINFO=y
CONFIG_CMD_CLK=y
CONFIG_CMD_FASTBOOT_ABORT_KEYED=y
CONFIG_CMD_GPIO=y
CONFIG_CMD_MMC=y
CONFIG_CMD_READ=y
CONFIG_CMD_USB=y
CONFIG_CMD_USB_MASS_STORAGE=y
CONFIG_CMD_UMS_ABORT_KEYED=y
CONFIG_CMD_WRITE=y
CONFIG_CMD_PAUSE=y
CONFIG_CMD_SYSBOOT=y
CONFIG_CMD_PMIC=y
CONFIG_CMD_LOG=y
CONFIG_PARTITION_TYPE_GUID=y
CONFIG_OF_UPSTREAM_BUILD_VENDOR=y
CONFIG_ENV_IS_IN_MMC=y
CONFIG_ENV_REDUNDANT=y
CONFIG_ENV_MMC_USE_DT=y
CONFIG_ENV_USE_DEFAULT_ENV_TEXT_FILE=y
CONFIG_ENV_DEFAULT_ENV_TEXT_FILE="board/qualcomm/fairphone-fp2.env"
CONFIG_PROT_TCP=y
CONFIG_NET_RANDOM_ETHADDR=y
CONFIG_BLKMAP=y
CONFIG_BUTTON_REMAP_PHONE_KEYS=y
CONFIG_BUTTON_QCOM_PMIC=y
CONFIG_CLK=y
CONFIG_CLK_STUB=y
CONFIG_CLK_QCOM_MSM8974=y
CONFIG_USB_FUNCTION_FASTBOOT=y
CONFIG_UDP_FUNCTION_FASTBOOT=y
CONFIG_TCP_FUNCTION_FASTBOOT=y
CONFIG_FASTBOOT_BUF_ADDR=0x40000000
CONFIG_FASTBOOT_BUF_SIZE=0x20000000
CONFIG_FASTBOOT_FLASH=y
CONFIG_FASTBOOT_FLASH_MMC_DEV=0
CONFIG_FASTBOOT_CMD_OEM_CONSOLE=y
CONFIG_QCOM_PMIC_GPIO=y
CONFIG_DM_KEYBOARD=y
CONFIG_BUTTON_KEYBOARD=y
CONFIG_SYS_MMC_MAX_BLK_COUNT=16384
CONFIG_MMC_SDHCI=y
CONFIG_MMC_SDHCI_MSM=y
CONFIG_PINCTRL=y
CONFIG_DM_PMIC=y
CONFIG_PMIC_QCOM=y
# CONFIG_REQUIRE_SERIAL_CONSOLE is not set
CONFIG_MSM_SERIAL=y
CONFIG_SPMI_MSM=y
CONFIG_USB=y
# CONFIG_DM_USB_GADGET is not set
CONFIG_USB_EHCI_HCD=y
CONFIG_USB_EHCI_MSM=y
CONFIG_USB_HOST_ETHER=y
CONFIG_USB_ETHER_ASIX=y
CONFIG_USB_ETHER_ASIX88179=y
CONFIG_USB_ETHER_MCS7830=y
CONFIG_USB_ETHER_RTL8152=y
CONFIG_USB_ETHER_SMSC95XX=y
CONFIG_USB_GADGET=y
CONFIG_USB_GADGET_MANUFACTURER="Fairphone"
CONFIG_CI_UDC=y
CONFIG_USB_FUNCTION_ACM=y
CONFIG_VIDEO=y
# CONFIG_VIDEO_FONT_8X16 is not set
CONFIG_VIDEO_FONT_16X32=y
CONFIG_SYS_WHITE_ON_BLACK=y
CONFIG_VIDEO_QCOM_MDP5_SPLASH=y
# CONFIG_TOOLS_MKEFICAPSULE is not set
```
